## Kconfig
```kconfig
menu "Edgelab Configuration"

    rsource "porting/Kconfig"

    config EL_DEBUG
        bool "Debug"
        default y
        help
            "Enable debugging"

    menu "Debug Options"
        depends on EL_DEBUG
        config EL_DEBUG_COLOR
            bool "color"
            default y
            help
                "Debug color"

        config EL_DEBUG_MORE_INFO
            bool "more info"
            default y
            help
               "Debug show more info"

        config EL_DEBUG_LEVEL
            int "level"
            default 3
            range 0 4
            help
                "Debug log level"

        config EL_ASSERT
            bool "assert"
            default y
            help
                "Enable assert"
    endmenu

    rsource "core/engine/Kconfig"
    rsource "third_party/Kconfig"

endmenu
```

## core/engine/Kconfig
```kconfig
menu "Inference Engine"
    config EL_TFLITE
        bool "Enable TFLite"
        default y
        help
            "Enable TFLite inference engine"

    menu "TFLite Options"
        depends on EL_TFLITE

        config EL_TFLITE_OP_ABS
            bool "ABS"
            default n
            help
                ABS

        config EL_TFLITE_OP_ADD
            bool "ADD"
            default y
            help
                ADD

        config EL_TFLITE_OP_ADDN
            bool "ADDN"
            default n
            help
                ADDN

        config EL_TFLITE_OP_ARGMAX
            bool "ARGMAX"
            default n
            help
                ARGMAX

        config EL_TFLITE_OP_ARGMIN
            bool "ARGMIN"
            default n
            help
                ARGMIN

        config EL_TFLITE_OP_ASSIGN_VARIABLE
            bool "ASSIGN_VARIABLE"
            default n
            help
                ASSIGN_VARIABLE

        config EL_TFLITE_OP_AVERAGE_POOL_2D
            bool "AVERAGE_POOL_2D"
            default n
            help
                AVERAGE_POOL_2D

        config EL_TFLITE_OP_BATCH_TO_SPACE_ND
            bool "BATCH_TO_SPACE_ND"
            default n
            help
                BATCH_TO_SPACE_ND

        config EL_TFLITE_OP_BROADCAST_ARGS
            bool "BROADCAST_ARGS"
            default n
            help
                BROADCAST_ARGS

        config EL_TFLITE_OP_BROADCAST_TO
            bool "BROADCAST_TO"
            default n
            help
                BROADCAST_TO

        config EL_TFLITE_OP_CALL_ONCE
            bool "CALL_ONCE"
            default n
            help
                CALL_ONCE

        config EL_TFLITE_OP_CAST
            bool "CAST"
            default n
            help
                CAST

        config EL_TFLITE_OP_CEIL
            bool "CEIL"
            default n
            help
                CEIL

        config EL_TFLITE_OP_CIRULAR_BUFFER
            bool "CIRULAR_BUFFER"
            default n
            help
                CIRULAR_BUFFER

        config EL_TFLITE_OP_CONCATENATION
            bool "CONCATENATION"
            default y
            help
                CONCATENATION

        config EL_TFLITE_OP_CONV_2D
            bool "CONV_2D"
            default y
            help
                CONV_2D

        config EL_TFLITE_OP_COS
            bool "COS"
            default n
            help
                COS

        config EL_TFLITE_OP_CUM_SUM
            bool "CUM_SUM"
            default n
            help
                CUM_SUM

        config EL_TFLITE_OP_DEPTH_TO_SPACE
            bool "DEPTH_TO_SPACE"
            default n
            help
                DEPTH_TO_SPACE

        config EL_TFLITE_OP_DEPTHWISE_CONV_2D
            bool "DEPTHWISE_CONV_2D"
            default n
            help
                DEPTHWISE_CONV_2D

        config EL_TFLITE_OP_DEQUANTIZE
            bool "DEQUANTIZE"
            default n
            help
                DEQUANTIZE

        config EL_TFLITE_OP_DETECTION_POSTPROCESS
            bool "DETECTION_POSTPROCESS"
            default n
            help
                DETECTION_POSTPROCESS

        config EL_TFLITE_OP_DIV
            bool "DIV"
            default n
            help
                DIV

        config EL_TFLITE_OP_ELU
            bool "ELU"
            default n
            help
                ELU

        config EL_TFLITE_OP_EQUAL
            bool "EQUAL"
            default n
            help
                EQUAL

        config EL_TFLITE_ETHOS_U
            bool "Enable TFLite ETHOS_U"
            default n
            help
                Enable TFLite ETHOS_U

        config EL_TFLITE_OP_EXP
            bool "EXP"
            default n
            help
                EXP

        config EL_TFLITE_OP_EXPAND_DIMS
            bool "EXPAND_DIMS"
            default n
            help
                EXPAND_DIMS

        config EL_TFLITE_OP_FILL
            bool "FILL"
            default n
            help
                FILL

        config EL_TFLITE_OP_FLOOR
            bool "FLOOR"
            default n
            help
                FLOOR

        config EL_TFLITE_OP_FLOOR_DIV
            bool "FLOOR_DIV"
            default n
            help
                FLOOR_DIV

        config EL_TFLITE_OP_FLOOR_MOD
            bool "FLOOR_MOD"
            default n
            help
                FLOOR_MOD

        config EL_TFLITE_OP_FULLY_CONNECTED
            bool "FULLY_CONNECTED"
            default n
            help
                FULLY_CONNECTED

        config EL_TFLITE_OP_GATHER
            bool "GATHER"
            default n
            help
                GATHER

        config EL_TFLITE_OP_GATHER_ND
            bool "GATHER_ND"
            default n
            help
                GATHER_ND

        config EL_TFLITE_OP_GREATER
            bool "GREATER"
            default n
            help
                GREATER

        config EL_TFLITE_OP_GREATER_EQUAL
            bool "GREATER_EQUAL"
            default n
            help
                GREATER_EQUAL

        config EL_TFLITE_OP_HARD_SWISH
            bool "HARD_SWISH"
            default n
            help
                HARD_SWISH


        config EL_TFLITE_OP_L2_NORMALIZATION
            bool "L2_NORMALIZATION"
            default n
            help
                L2_NORMALIZATION

        config EL_TFLITE_OP_L2_POOL_2D
            bool "L2_POOL_2D"
            default n
            help
                L2_POOL_2D

        config EL_TFLITE_OP_LEAKY_RELU
            bool "LEAKY_RELU"
            default y
            help
                LEAKY_RELU

        config EL_TFLITE_OP_LESS
            bool "LESS"
            default n
            help
                LESS

        config EL_TFLITE_OP_LESS_EQUAL
            bool "LESS_EQUAL"
            default n
            help
                LESS_EQUAL

        config EL_TFLITE_OP_LOG
            bool "LOG"
            default n
            help
                LOG

        config EL_TFLITE_OP_LOGICAL_AND
            bool "LOGICAL_AND"
            default n
            help
                LOGICAL_AND

        config EL_TFLITE_OP_LOGICAL_NOT
            bool "LOGICAL_NOT"
            default n
            help
                LOGICAL_NOT

        config EL_TFLITE_OP_LOGICAL_OR
            bool "LOGICAL_OR"
            default n
            help
                LOGICAL_OR

        config EL_TFLITE_OP_LOGISTIC
            bool "LOGISTIC"
            default y
            help
                LOGISTIC

        config EL_TFLITE_OP_LOG_SOFTMAX
            bool "LOG_SOFTMAX"
            default n
            help
                LOG_SOFTMAX

        config EL_TFLITE_OP_MAX_POOL_2D
            bool "MAX_POOL_2D"
            default y
            help
                MAX_POOL_2D

        config EL_TFLITE_OP_MAXIMUM
            bool "MAXIMUM"
            default n
            help
                MAXIMUM

        config EL_TFLITE_OP_MEAN
            bool "MEAN"
            default y
            help
                MEAN

        config EL_TFLITE_OP_MINIMUM
            bool "MINIMUM"
            default n
            help
                MINIMUM

        config EL_TFLITE_OP_MIRROR_PAD
            bool "MIRROR_PAD"
            default n
            help
                MIRROR_PAD

        config EL_TFLITE_OP_MUL
            bool "MUL"
            default y
            help
                MUL

        config EL_TFLITE_OP_NEG
            bool "NEG"
            default n
            help
                NEG

        config EL_TFLITE_OP_NOT_EQUAL
            bool "NOT_EQUAL"
            default n
            help
                NOT_EQUAL

        config EL_TFLITE_OP_PACK
            bool "PACK"
            default n
            help
                PACK

        config EL_TFLITE_OP_PAD
            bool "PAD"
            default y
            help
                PAD

        config EL_TFLITE_OP_PADV2
            bool "PADV2"
            default y
            help
                PADV2

        config EL_TFLITE_OP_PRELU
            bool "PRELU"
            default n
            help
                PRELU

        config EL_TFLITE_OP_QUANTIZE
            bool "QUANTIZE"
            default y
            help
                QUANTIZE

        config EL_TFLITE_OP_READ_VARIABLE
            bool "READ_VARIABLE"
            default n
            help
                READ_VARIABLE

        config EL_TFLITE_OP_REDUCE_ANY
            bool "REDUCE_ANY"
            default n
            help
                REDUCE_ANY

        config EL_TFLITE_OP_RELU
            bool "RELU"
            default y
            help
                RELU

        config EL_TFLITE_OP_RELU6
            bool "RELU6"
            default n
            help
                RELU6

        config EL_TFLITE_OP_RESHAPE
            bool "RESHAPE"
            default y
            help
                RESHAPE

        config EL_TFLITE_OP_RESIZE_BILINEAR
            bool "RESIZE_BILINEAR"
            default n
            help
                RESIZE_BILINEAR

        config EL_TFLITE_OP_RESIZE_NEAREST_NEIGHBOR
            bool "RESIZE_NEAREST_NEIGHBOR"
            default y
            help
                RESIZE_NEAREST_NEIGHBOR

        config EL_TFLITE_OP_ROUND
            bool "ROUND"
            default n
            help
                ROUND

        config EL_TFLITE_OP_RSQRT
            bool "RSQRT"
            default n
            help
                RSQRT

        config EL_TFLITE_OP_SELECT_V2
            bool "SELECT_V2"
            default n
            help
                SELECT_V2

        config EL_TFLITE_OP_SHAPE
            bool "SHAPE"
            default y
            help
                SHAPE

        config EL_TFLITE_OP_SIN
            bool "SIN"
            default n
            help
                SIN

        config EL_TFLITE_OP_SLICE
            bool "SLICE"
            default n
            help
                SLICE

        config EL_TFLITE_OP_SOFTMAX
            bool "SOFTMAX"
            default y
            help
                SOFTMAX

        config EL_TFLITE_OP_SPACE_TO_BATCH_ND
            bool "SPACE_TO_BATCH_ND"
            default n
            help
                SPACE_TO_BATCH_ND

        config EL_TFLITE_OP_SPACE_TO_DEPTH
            bool "SPACE_TO_DEPTH"
            default n
            help
                SPACE_TO_DEPTH

        config EL_TFLITE_OP_SPLIT
            bool "SPLIT"
            default y
            help
                SPLIT

        config EL_TFLITE_OP_SPLIT_V
            bool "SPLIT_V"
            default y
            help
                SPLIT_V

        config EL_TFLITE_OP_SQRT
            bool "SQRT"
            default n
            help
                SQRT

        config EL_TFLITE_OP_SQUARE
            bool "SQUARE"
            default n
            help
                SQUARE

        config EL_TFLITE_OP_SQUARED_DIFFERENCE
            bool "SQUARED_DIFFERENCE"
            default n
            help
                SQUARED_DIFFERENCE

        config EL_TFLITE_OP_SQUEEZE
            bool "SQUEEZE"
            default n
            help
                SQUEEZE

        config EL_TFLITE_OP_STRIDED_SLICE
            bool "STRIDED_SLICE"
            default y
            help
                STRIDED_SLICE

        config EL_TFLITE_OP_SUB
            bool "SUB"
            default y
            help
                SUB

        config EL_TFLITE_OP_SUM
            bool "SUM"
            default n
            help
                SUM

        config EL_TFLITE_SVDF
            bool "SVDF"
            default n
            help
                SVDF

        config EL_TFLITE_OP_TANH
            bool "TANH"
            default n
            help
                TANH

        config EL_TFLITE_OP_TRANSPOSE
            bool "TRANSPOSE"
            default y
            help
                TRANSPOSE

        config EL_TFLITE_OP_TRANSPOSE_CONV
            bool "TRANSPOSE_CONV"
            default n
            help
                TRANSPOSE_CONV

        config EL_TFLITE_OP_UNIDIRECTIONAL_SEQUENCE_LSTM
            bool "UNIDIRECTIONAL_SEQUENCE_LSTM"
            default n
            help
                UNIDIRECTIONAL_SEQUENCE_LSTM

        config EL_TFLITE_OP_UNPACK
            bool "UNPACK"
            default n
            help
                UNPACK

        config EL_TFLITE_OP_VARHANDLE
            bool "VARHANDLE"
            default n
            help
                VARHANDLE

        config EL_TFLITE_OP_WHILE
            bool "WHILE"
            default n
            help
                WHILE

        config EL_TFLITE_OP_ZEROS_LIKE
            bool "ZEROS_LIKE"
            default n
            help
                ZEROS_LIKE
    endmenu
endmenu
```

## porting/Kconfig
```kconfig
choice "Target"
    default EL_TARGET_ESPPRESSIF
    prompt "Target"
    help
        Select the target system for which you want to build the firmware.

    config EL_TARGET_ESPPRESSIF
        bool "Espressif"
        default y

    config EL_TARGET_HIMAX
        bool "Himax"
        default n

endchoice

rsource "espressif/Kconfig"
```

## porting/espressif/Kconfig
```kconfig
choice
    prompt "Board"
    depends on EL_TARGET_ESPPRESSIF
    default EL_BOARD_SEEED_XIAO_ESP32S3
    help
        Select the board you want to build the firmware for.

    config EL_BOARD_SEEED_XIAO_ESP32S3
        bool "Seeed Xiao ESP32-S3"
        default y

    config EL_BOARD_ESPRESSIF_ESP32S3_EYE
        bool "Espressif ESP32-S3-EYE"
        default n

endchoice
```

## third_party/Kconfig
```kconfig
menu "Third Party"
    config EL_LIB_FLASHDB
        bool "FlashDB"
        default y
        help
            Enable SoftWare FlashDB
    config EL_LIB_JPEGENC
        bool "JPEGENC"
        default y
        help
            Enable SoftWare JPEG encoder
endmenu
```
